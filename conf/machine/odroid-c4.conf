## conf/machine/odroid-c4.conf
```bitbake
#@TYPE: Machine
#@NAME: odroid-c4
#@DESCRIPTION: Machine configuration for odroid-c4 systems
#@MAINTAINER: Armin Kuster <akuster808@gmail.com>

require conf/machine/include/arm/armv8-2a/tune-cortexa55.inc
require conf/machine/include/amlogic-meson64.inc
require conf/machine/include/odroid-arm-defaults.inc

SERIAL_CONSOLE = "115200 ttyS0"

KERNEL_DEVICETREE = "amlogic/meson-sm1-odroid-c4.dtb"

UBOOT_BINARY = "u-boot.bin.sd.bin"

UBOOT_MACHINE = "odroid-c4_defconfig"

UBOOT_ENTRYPOINT = "0x1B00000"
UBOOT_LOADADDRESS = "0x1B00000"

#UBOOT_FILE_TITLE = "ODROIDC4-UBOOT-CONFIG"
UBOOT_VIDEO = "no_console_suspend fsck.repair=yes net.ifnames=0 elevator=noop cma=256M display_autodetect=true hdmimode=1080p60hz cvbsmode=576cvbs max_freq_a55=1908 max_freq_a73= maxcpus=4 voutmode=hdmi disablehpd=false cvbscable= overscan=100  monitor_onoff=false logo=osd0,loaded hdmitx=cec3f sdrmode=auto"

IMAGE_BOOT_FILES = "${UBOOT_SCRIPT}"

WKS_FILE ?= "odroid-c4.wks"
```
